// File generated 11/16/2014 3:55:33 PM
// Warning! This is a generated file, any manual changes will be
// lost during the next generation.

#constant  Strings0Count    1
#constant  Strings0Size     30
// object indexes into ImageControl
#CONST
    iLeddigits0     // offset 0x0
    iiLeddigits0    // offset 0x9800
    iLeddigits1     // offset 0x61000
    iiLeddigits1    // offset 0x6A800
    iLeddigits2     // offset 0xC2000
    iiLeddigits2    // offset 0xC5E00
    iLeddigits3     // offset 0xE9000
    iiLeddigits3    // offset 0xECE00
    iStatictext0    // offset 0x110000
    iLeddigits4     // offset 0x111C00
    iiLeddigits4    // offset 0x114000
    iLeddigits5     // offset 0x11E200
    iiLeddigits5    // offset 0x120600
    iStatictext1    // offset 0x12A800
    iLeddigits6     // offset 0x12AE00
    iiLeddigits6    // offset 0x12CE00
    iLeddigits7     // offset 0x136200
    iiLeddigits7    // offset 0x138200
    iLeddigits8     // offset 0x141600
    iiLeddigits8    // offset 0x145400
    iLeddigits9     // offset 0x168600
    iiLeddigits9    // offset 0x16C400
    iStatictext3    // offset 0x18F600
    iLeddigits10    // offset 0x190A00
    iiLeddigits10   // offset 0x192E00
    iStatictext5    // offset 0x19D000
    iLeddigits11    // offset 0x19D600
    iiLeddigits11   // offset 0x19FA00
    iStatictext6    // offset 0x1A9C00
    iWinbutton0     // offset 0x1AB000
    iWinbutton1     // offset 0x1B4600
    iStatictext2    // offset 0x1BDC00
    iStatictext8    // offset 0x1BE800
    iLeddigits12    // offset 0x1BF400
    iiLeddigits12   // offset 0x1C0A00
    iLeddigits13    // offset 0x1C7200
    iiLeddigits13   // offset 0x1C8800
    iStatictext7    // offset 0x1CF000
    iWinbutton2     // offset 0x1FB600
    iWinbutton3     // offset 0x221A00
    iWinbutton4     // offset 0x247E00
    iWinbutton5     // offset 0x253A00
    iStatictext4    // offset 0x25F600
#END

#constant  Strings0StartH   0x0
#constant  Strings0StartL   0x0
#IFNOT EXISTS NOGLOBALS
var disk, hndl ;
#ENDIF
